## boards/shields/nickey44a/dts/bindings/input/processor/input-processor-pinch-zoom.yaml
```yaml
description: Tap the zoom-out or zoom-in shortcut for a signed TPS43 pinch event
compatible: "zmk,input-processor-pinch-zoom"
include: ip_two_param.yaml
```

## boards/shields/nickey44a/dts/bindings/input/processor/input-processor-tap-drag.yaml
```yaml
description: Tap-drag with a double-tap interval and a finger repositioning interval (ms)
compatible: "zmk,input-processor-tap-drag"
include: ip_two_param.yaml
```

## boards/shields/nickey44a/dts/bindings/input/processor/input-processor-tps43-accel.yaml
```yaml
description: Apply a speed-dependent gain to relative cursor motion from one TPS43
compatible: "zmk,input-processor-tps43-accel"
include: ip_zero_param.yaml
```

## boards/shields/tps43_no_pinch/Kconfig.shield
```kconfig
config SHIELD_TPS43_NO_PINCH
    def_bool $(shields_list_contains,tps43_no_pinch)
```

## config/west.yml
```yaml
manifest:
  remotes:
    - name: zmkfirmware
      url-base: https://github.com/zmkfirmware
    - name: cormoran
      url-base: https://github.com/cormoran
    - name: caksoylar  # <-- RGB LED
      url-base: https://github.com/caksoylar
    - name: yamaryu211
      url-base: https://github.com/yamaryu211
    - name: geeksville
      url-base: https://github.com/geeksville
  projects:
    - name: zmk
      remote: cormoran
      revision: e5c9b6915b56801193e359dd9bad4a167ce0d1b8
      import: app/west.yml
    - name: zmk-rgbled-widget
      remote: caksoylar
      revision: e6b467792a1dabef8cfa5c9fd26bfefc9c16662b
    - name: zmk_driver_azoteq
      remote: geeksville
      revision: 66d510249d139569a4060c35bd78c6a2159f83ed
    - name: zmk-feature-default-layer
      remote: cormoran
      revision: b25cb5b324da2d9bbc84e1877c775f5b2b7c6845
    - name: zmk-input-processor-temp-layer-threshold
      remote: yamaryu211
      revision: bd9fafb1fe29066f67bfad52931065b4330d417d
    - name: zmk-module-ble-management
      remote: cormoran
      revision: 57738cc4fc6ba80e82a7ac57741a0339cb186cd4
    - name: zmk-module-settings-rpc
      remote: cormoran
      revision: 78f86df9e6c5edaf57bef3ccbd7f360cfdf49291
    - name: zmk-module-runtime-input-processor
      remote: cormoran
      revision: decf628d7ce5ed95b520c650824c28ea9de649c1
    - name: zmk-feature-custom-settings
      remote: cormoran
      revision: c6a7fef3a3be3d3ace5de9a4b0628c6418cd1f3f
    - name: zmk-feature-runtime-combo
      remote: cormoran
      revision: d9490e7b5d41c516221d131241009e81740efcee
    - name: zmk-feature-runtime-macro
      remote: cormoran
      revision: 38530962eb7061b60efcb98e84585cfb1f0cb6de
    - name: zmk-feature-os-detection
      remote: cormoran
      revision: 3052679f645b8fc1997275c2eaa6b86bdd55ca01
    - name: zmk-feature-device-info
      remote: cormoran
      revision: 8cedd2dd9f04e19ea5a17b94914dd47a09d8db11
    - name: zmk-feature-kscan-diagnostics
      remote: cormoran
      revision: 1432f7fe0cfe903cd7d3c9931ae6bd6f2e1f328e
    - name: zmk-feature-watchdog
      remote: cormoran
      revision: 84ad14c6c3645dc40b23f45d08ab45418655f912
    - name: zmk-feature-input-stream
      remote: cormoran
      revision: aeb015908a42a7615ccdccc7feb3a10d23132a71
  self:
    path: config
```
